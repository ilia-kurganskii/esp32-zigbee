## zigbee-co2/components/esp_analytics/Kconfig
```kconfig
menu "ESP Analytics Configuration"

config ESP_ANALYTICS_SERVER_URL
    string "Analytics server URL"
    default "http://localhost:8080/api/v1/telemetry"
    help "URL of the telemetry service endpoint for analytics data"

config ESP_ANALYTICS_API_KEY
    string "API key for authentication"
    default ""
    help "API key for authenticating with the telemetry service"

config ESP_ANALYTICS_DEVICE_ID
    string "Device identifier"
    default "esp32-device"
    help "Unique identifier for this device in analytics"

config ESP_ANALYTICS_TRANSMISSION_INTERVAL_SEC
    int "Transmission interval (seconds)"
    range 30 3600
    default 300
    help "How often to transmit buffered analytics data"

config ESP_ANALYTICS_ENABLE_DEEP_SLEEP
    bool "Enable deep sleep between transmissions"
    default y
    help "Enable deep sleep mode to save power between transmissions"

config ESP_ANALYTICS_BUFFER_SIZE
    int "Metric buffer size"
    range 10 1000
    default 100
    help "Maximum number of metrics to buffer before transmission"

config ESP_ANALYTICS_ENABLE_WIFI_POWER_SAVE
    bool "Enable WiFi power saving"
    default y
    help "Enable WiFi power saving mode during transmission"

config ESP_ANALYTICS_RETRY_ATTEMPTS
    int "Maximum retry attempts for failed transmissions"
    range 0 10
    default 3
    help "Number of retry attempts for failed HTTP requests"

config ESP_ANALYTICS_LOG_LEVEL
    int "Analytics component log level"
    range 0 5
    default 2
    help "Log level: 0=NONE, 1=ERROR, 2=WARN, 3=INFO, 4=DEBUG, 5=VERBOSE"

endmenu
```

## zigbee-co2/components/scd40/Kconfig
```kconfig
menu "SCD40 CO2 Sensor Configuration"

    config SCD40_I2C_TIMEOUT_MS
        int "I2C communication timeout (ms)"
        default 1000
        range 100 5000
        help
            Timeout for I2C communication operations in milliseconds.

    config SCD40_ENABLE_DEBUG_LOGS
        bool "Enable debug logging"
        default n
        help
            Enable detailed debug logging for SCD40 driver operations.

    config SCD40_DEFAULT_ALTITUDE
        int "Default sensor altitude (meters)"
        default 0
        range 0 3000
        help
            Default altitude in meters above sea level for CO2 compensation.
            This can be changed at runtime using scd40_set_sensor_altitude().

    config SCD40_ENABLE_ASC_BY_DEFAULT
        bool "Enable automatic self-calibration by default"
        default y
        help
            Enable automatic self-calibration (ASC) feature by default.
            ASC uses the lowest CO2 concentration measured during a week
            as a reference for 400 ppm. Only enable in well-ventilated areas.

endmenu
```

## zigbee-co2/sdkconfig.defaults
```kconfig
#
# Partition Table
#
CONFIG_PARTITION_TABLE_SINGLE_APP=y
CONFIG_PARTITION_TABLE_CUSTOM=y
CONFIG_PARTITION_TABLE_CUSTOM_FILENAME="partitions.csv"
CONFIG_PARTITION_TABLE_FILENAME="partitions.csv"
CONFIG_PARTITION_TABLE_OFFSET=0x8000
CONFIG_PARTITION_TABLE_MD5=y
# end of Partition Table

#
# Serial Flasher Config
#
CONFIG_ESPTOOLPY_FLASHSIZE_4MB=y
CONFIG_ESPTOOLPY_FLASHSIZE="4MB"
# end of Serial Flasher Config

#
# mbedTLS
#
CONFIG_MBEDTLS_HARDWARE_AES=n
CONFIG_MBEDTLS_HARDWARE_MPI=n
CONFIG_MBEDTLS_HARDWARE_SHA=n
CONFIG_MBEDTLS_CMAC_C=y
CONFIG_MBEDTLS_SSL_PROTO_DTLS=y
CONFIG_MBEDTLS_KEY_EXCHANGE_ECJPAKE=y
# end of TLS Key Exchange Methods

CONFIG_MBEDTLS_ECJPAKE_C=y
# end of mbedTLS

#
# Zboss
#
CONFIG_ZB_ENABLED=y
CONFIG_ZB_ZED=y
CONFIG_ZB_RADIO_NATIVE=y
# end of Zboss

#
# IEEE802154
#
CONFIG_IEEE802154_RECEIVE_DONE_HANDLER=y
# end of IEEE802154
# end of Component config

#
# ESP Analytics Configuration
#
CONFIG_ESP_ANALYTICS_SERVER_URL="http://localhost:8080/api/v1/telemetry"
CONFIG_ESP_ANALYTICS_API_KEY=""
CONFIG_ESP_ANALYTICS_DEVICE_ID="esp32-co2-sensor"
CONFIG_ESP_ANALYTICS_TRANSMISSION_INTERVAL_SEC=300
CONFIG_ESP_ANALYTICS_ENABLE_DEEP_SLEEP=y
CONFIG_ESP_ANALYTICS_BUFFER_SIZE=100
CONFIG_ESP_ANALYTICS_ENABLE_WIFI_POWER_SAVE=y
CONFIG_ESP_ANALYTICS_RETRY_ATTEMPTS=3
CONFIG_ESP_ANALYTICS_LOG_LEVEL=2
# end of ESP Analytics Configuration

#
# WiFi Configuration
#
CONFIG_ESP_WIFI_ENABLED=y
CONFIG_ESP_WIFI_SSID="your_wifi_ssid"
CONFIG_ESP_WIFI_PASSWORD="your_wifi_password"
CONFIG_ESP_WIFI_SCAN_AUTH_MODE_THRESHOLD=3
CONFIG_ESP_WIFI_CONNECT_AP_SCAN_TIMEOUT=5000
CONFIG_ESP_WIFI_CONNECT_STA_SAVE_RECONNECT=y
CONFIG_ESP_WIFI_CONNECT_STA_CONNECT_POLICY_FAST=y
CONFIG_ESP_WIFI_CONNECT_STA_CONNECT_POLICY_KEEP_CONNECT=y
CONFIG_ESP_WIFI_STATIC_TX_BUFFER_NUM=10
CONFIG_ESP_WIFI_DYNAMIC_TX_BUFFER_NUM=32
CONFIG_ESP_WIFI_AMPDU_TX_ENABLED=y
CONFIG_ESP_WIFI_AMPDU_RX_ENABLED=y
CONFIG_ESP_WIFI_TX_BAW_ENFORCE=0
CONFIG_ESP_WIFI_NVS_ENABLED=y
# end of WiFi Configuration
```
